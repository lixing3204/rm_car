## board/Kconfig
```kconfig
menu "Hardware Drivers Config"

config SOC_STM32F103RC
    bool
    select SOC_SERIES_STM32F1
    default y

menu "Onboard Peripheral Drivers"
		
endmenu

menu "On-chip Peripheral Drivers"

    config BSP_USING_GPIO
        bool "Enable GPIO"
        select RT_USING_PIN
        default y

    menuconfig BSP_USING_UART
        bool "Enable UART"
        default y
        select RT_USING_SERIAL
        if BSP_USING_UART
            config BSP_USING_UART3
                bool "Enable UART3"
                default y

            config BSP_USING_UART5
                bool "Enable UART5"
                default y
        endif

    menuconfig BSP_USING_SPI
        bool "Enable SPI BUS"
        default n
        select RT_USING_SPI
        if BSP_USING_SPI
            config BSP_USING_SPI1
                bool "Enable SPI1 BUS"
                default n

            config BSP_SPI1_TX_USING_DMA
                bool "Enable SPI1 TX DMA"
                depends on BSP_USING_SPI1
                default n
                
            config BSP_SPI1_RX_USING_DMA
                bool "Enable SPI1 RX DMA"
                depends on BSP_USING_SPI1
                select BSP_SPI1_TX_USING_DMA
                default n
        endif
    menuconfig BSP_USING_TIM
        bool "Enable timer"
        default n
        select RT_USING_HWTIMER
        if BSP_USING_TIM
            config BSP_USING_TIM1
                bool "Enable TIM1"
                default n
            config BSP_USING_TIM2
                bool "Enable TIM2"
                default n
			config BSP_USING_TIM3
                bool "Enable TIM3"
                default n
			config BSP_USING_TIM4
                bool "Enable TIM4"
                default n
			config BSP_USING_TIM5
                bool "Enable TIM5"
                default n
        endif
		menuconfig BSP_USING_PWM
        bool "Enable pwm"
        default n
        select BSP_USING_PWM
        if BSP_USING_PWM
		    menuconfig BSP_USING_PWM1
            bool "Enable timer1 output pwm"
            default n
            if BSP_USING_PWM1
                config BSP_USING_PWM1_CH4
                    bool "Enable pwm1 channel4"
                    default n
			endif
            if BSP_USING_PWM1
                config BSP_USING_PWM1_CH3
                    bool "Enable pwm1 channel3"
                    default n
			endif
            if BSP_USING_PWM1
                config BSP_USING_PWM1_CH2
                    bool "Enable pwm1 channel2"
                    default n
			endif
            if BSP_USING_PWM1
                config BSP_USING_PWM1_CH1
                    bool "Enable pwm1 channel1"
                    default n
			endif
			menuconfig BSP_USING_PWM8
            bool "Enable timer8 output pwm"
            default n
            if BSP_USING_PWM8
                config BSP_USING_PWM8_CH4
                    bool "Enable pwm8 channel4"
                    default n
			endif
            if BSP_USING_PWM8
                config BSP_USING_PWM8_CH3
                    bool "Enable pwm8 channel3"
                    default n
			endif
            if BSP_USING_PWM8
                config BSP_USING_PWM8_CH2
                    bool "Enable pwm8 channel2"
                    default n
			endif
            if BSP_USING_PWM8
                config BSP_USING_PWM8_CH1
                    bool "Enable pwm8 channel1"
                    default n
			endif
			menuconfig BSP_USING_PWM5
            bool "Enable timer5 output pwm"
            default n
            if BSP_USING_PWM5
                config BSP_USING_PWM5_CH4
                    bool "Enable pwm5 channel4"
                    default n
			endif
            if BSP_USING_PWM5
                config BSP_USING_PWM5_CH3
                    bool "Enable pwm5 channel3"
                    default n
			endif
            if BSP_USING_PWM5
                config BSP_USING_PWM5_CH2
                    bool "Enable pwm5 channel2"
                    default n
			endif
            if BSP_USING_PWM5
                config BSP_USING_PWM5_CH1
                    bool "Enable pwm5 channel1"
                    default n
			endif
        endif
		menuconfig BSP_USING_ADC
        bool "Enable ADC"
        default n
		select BSP_USING_ADC
        if BSP_USING_ADC
            config BSP_USING_ADC1
                bool "Enable ADC1"
                default y
	    endif
endmenu

menu "Board extended module Drivers"

endmenu

endmenu
```
